## sdkconfig.defaults
```kconfig
CONFIG_ESPTOOLPY_FLASHSIZE_4MB=y
CONFIG_PARTITION_TABLE_CUSTOM=y
CONFIG_PARTITION_TABLE_CUSTOM_FILENAME="partitions.csv"
CONFIG_FATFS_LFN_HEAP=y
CONFIG_ESP_MAIN_TASK_STACK_SIZE=8192

#LOG NONE
#CONFIG_ESP_CONSOLE_NONE=y
#CONFIG_BOOTLOADER_LOG_LEVEL_NONE=y
#CONFIG_LOG_DEFAULT_LEVEL_NONE=y

# Console output to UART1 (GPIO32=RX, GPIO33=TX) to free UART0 for fs_proxy
CONFIG_CONSOLE_UART_CUSTOM=y
CONFIG_ESP_CONSOLE_UART_CUSTOM_NUM_1=y
CONFIG_CONSOLE_UART_TX_GPIO=32
CONFIG_CONSOLE_UART_RX_GPIO=33
CONFIG_CONSOLE_UART_BAUDRATE=115200
```
